## subsys/storage/flash_buffered_write/Kconfig
```kconfig
#
# Copyright (c) 2020 Nordic Semiconductor ASA
#
# SPDX-License-Identifier: Apache-2.0
#

menuconfig FLASH_BUFFERED_WRITE
	bool "Flash Buffered Write"
	select FLASH_PAGE_LAYOUT
	help
	  Enable support of flash buffered writes

if FLASH_BUFFERED_WRITE
config FBW_ERASE
	bool "Perform erase operations"
	help
	  If disabled an external actor must erase the flash area being written
	  to prior to invoking 'fbw_write'.

module = FBW
module-str = flash buffered write
source "subsys/logging/Kconfig.template.log_config"

endif # FLASH_BUFFERED_WRITE
```

## tests/subsys/storage/flash_buffered_write/testcase.yaml
```yaml
tests:
  storage.flash_buffered_write:
    platform_whitelist: native_posix native_posix_64
    tags: flash_buffered_write
  storage.flash_buffered_write.no_erase:
    extra_args: OVERLAY_CONFIG=no_erase.overlay
    platform_whitelist: native_posix native_posix_64
    tags: flash_buffered_write
  storage.flash_buffered_write.mpu_allow_flash_write:
    extra_args: OVERLAY_CONFIG=mpu_allow_flash_write.overlay
    platform_whitelist:  nrf52840_pca10056
    tags: flash_buffered_write
```
